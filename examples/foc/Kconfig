## examples/foc/Kconfig
```kconfig
#
# For a description of the syntax of this configuration file,
# see the file kconfig-language.txt in the NuttX tools repository.
#

menuconfig EXAMPLES_FOC
	tristate "FOC open-looop example"
	depends on POWER_FOC
	---help---
		Enable the FOC open-loop motor driver example

if EXAMPLES_FOC

config EXAMPLES_FOC_DEVPATH
	string "FOC device path prefix"
	default "/dev/foc"
	---help---
		The default path to the FOC device. Default: /dev/foc

if POWER_FOCMODEL

config EXAMPLES_FOC_MODEL_DEVPATH
	string "FOC model device path prefix"
	default "/dev/focmodel"
	---help---
		The default path to the FOC device. Default: /dev/focmodel

endif # POWER_FOCMODEL

config EXAMPLES_FOC_CONTROL_PRIO
	int "FOC example control thread priority"
	default 255

config EXAMPLES_FOC_CONTROL_STACKSIZE
	int "FOC example control thread stack size"
	default 4096

config EXAMPLES_FOC_VERBOSE
	int "Enable verbose print for app"
	default 1
	range 0 2

config EXAMPLES_FOC_STATE_THREAD
	bool "FOC example state thread"
	default n

config EXAMPLES_FOC_PWM_FREQ
       int "FOC PWM frequency"
       default 10000
       ---help---
           Select the FOC motor driver PWM switching frequency

config EXAMPLES_FOC_WORK_FREQ
       int "FOC work loop frequency"
       default 5000
       ---help---
           Select the FOC work frequency

config EXAMPLES_FOC_NOTIFIER_FREQ
       int "FOC notifier frequency"
       default EXAMPLES_FOC_WORK_FREQ
       ---help---
           Select the FOC notifier frequency

if EXAMPLES_FOC_STATE_THREAD

config EXAMPLES_FOC_STATE_PRIO
	int "FOC example state thread priority"
	default 100

config EXAMPLES_FOC_STATE_STACKSIZE
	int "FOC example state thread stack size"
	default 2048

choice
       prompt "FOC Example state thread interface "
       default EXAMPLES_FOC_STATE_PRINT

config EXAMPLES_FOC_STATE_SERIAL
	bool "FOC example state thread put data on serial"

config EXAMPLES_FOC_STATE_PRINT
	bool "FOC example state thread print data"

endchoice # FOC state interface

if EXAMPLES_FOC_STATE_SERIAL

config EXAMPLES_FOC_STATE_SERIAL_DEVPATH
	string "FOC example state serial devpath"
	default "/dev/ttyS1"
	---help---
		The default path to the serial device. Default: /dev/ttyS1

config EXAMPLES_FOC_STATE_SERIAL_DATA
	int "FOC example state thread serial data"
	default 0
	---help---
		Bit-encoded serial data configuration.
		For details look at enum foc_state_serial_data_e in foc_state_thr.c

endif # EXAMPLES_FOC_STATE_SERIAL

endif # EXAMPLES_FOC_STATE_THREAD

menu "FOC example user input"

config EXAMPLES_FOC_HAVE_ADC
	bool
	default n

choice
       prompt "FOC VBUS interface"
       default EXAMPLES_FOC_VBUS_CONST

config EXAMPLES_FOC_VBUS_CONST
	bool "Use hardcoded constant VBUS"

config EXAMPLES_FOC_VBUS_ADC
	bool "Use VBUS provided by ADC interface"
	depends on ADC
	select EXAMPLES_FOC_HAVE_ADC

endchoice # FOC VBUS interface

if EXAMPLES_FOC_VBUS_CONST

config EXAMPLES_FOC_VBUS_CONST_VALUE
	int "FOC VBUS constant value"
	default 12000

endif # EXAMPLES_FOC_VBUS_CONST

if EXAMPLES_FOC_HAVE_ADC

config EXAMPLES_FOC_ADC_DEVPATH
	string "FOC example ADC interface path"
	default "/dev/adc0"

config EXAMPLES_FOC_ADC_VREF
	int "FOC example ADC reference votlage [x1000]"
	default 0

config EXAMPLES_FOC_ADC_MAX
	int "FOC ADC aux maximum sample value"
	default 0

endif # EXAMPLES_FOC_HAVE_ADC

if EXAMPLES_FOC_VBUS_ADC

config EXAMPLES_FOC_VBUS_SCALE
	int "FOC VBUS SCALE scale [x1000]"
	default 0

endif # EXAMPLES_FOC_VBUS_ADC

choice
       prompt "FOC velocity interface"
       default EXAMPLES_FOC_VEL_CONST

config EXAMPLES_FOC_VEL_ADC
	bool "Use ADC to control velocity"
	select EXAMPLES_FOC_HAVE_ADC

config EXAMPLES_FOC_VEL_CONST
	bool "Use hardcoded constant velocity"

endchoice # FOC velocity interface

if EXAMPLES_FOC_VEL_CONST

config EXAMPLES_FOC_VEL_CONST_VALUE
	int "FOC example hardoced velocity valie"
	default 100000

endif # EXAMPLES_FOC_VEL_CONST

if EXAMPLES_FOC_VEL_ADC

config EXAMPLES_FOC_VEL_ADC_MAX
	int "FOC example maximum velocity from ADC [x1000]"
	default 100000

endif # EXAMPLES_FOC_VEL_ADC

config EXAMPLES_FOC_TIME_DEFAULT
	int "FOC example run time default (sec)"
	default 10

config EXAMPLES_FOC_STATE_INIT
	int "FOC example state init"
	default 1
	range 1 4
	---help---
		1 - motor FREE
		2 - motor STOP (active break)
		3 - motor CW direction
		4 - motor CCW direction

config EXAMPLES_FOC_HAVE_BUTTON
	bool "FOC example button support"
	default n

if EXAMPLES_FOC_HAVE_BUTTON

config EXAMPLES_FOC_BUTTON_DEVPATH
	string "FOC button dev path"
	default "/dev/buttons"
	depends on BUTTONS

endif

endmenu # FOC example user input

menu "FOC controller parameters"

config EXAMPLES_FOC_FOCMODE
	int "FOC example control mode"
	default 2
	range 1 3
	---help---
		1 - IDLE mode
		2 - FOC voltage mode (default)
		3 - FOC current mode

config EXAMPLES_FOC_OPENLOOP_Q
	int "FOC openloop Vq/Iq setting [x1000]"
	default 200

config EXAMPLES_FOC_IDQ_KP
	int "FOC example open-loop Id/Iq Kp gain [x1000]"
	default 0
	---help---
		It is set to 0 by default and must be properly configured by the user!
		Oterwise the example won't work. The vaules of Kp and Ki depend on
		the motor parameters, for more instructions see README.md for this example.

config EXAMPLES_FOC_IDQ_KI
	int "FOC example open-loop Id/Iq Ki gain [x1000]"
	default 0
	---help---
		It is set to 0 by default and must be properly configured by the user!
		Oterwise the example won't work. The vaules of Kp and Ki depend on
		the motor parameters, for more instructions see README.md for this example.

config EXAMPLES_FOC_RAMP_THR
	int "FOC example ramp velocity threshold [x1000]"
	default 0

config EXAMPLES_FOC_RAMP_ACC
	int "FOC example ramp velocity acc [x1000]"
	default 0

config EXAMPLES_FOC_RAMP_DEC
	int "FOC example ramp velocity acc [x1000]"
	default 0

endmenu # FOC controller parameters

endif # EXAMPLES_FOC
```
